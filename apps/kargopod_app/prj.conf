## CMakeLists.txt
```
# SPDX-License-Identifier: Apache-2.0
# Copyright (c) 2025 Kargo Chain

cmake_minimum_required(VERSION 3.20.0)

find_package(Zephyr REQUIRED HINTS $ENV{ZEPHYR_BASE})
project(kargopod_app)

target_sources(app PRIVATE
    src/main.c
    src/sensor_manager.c
    src/mqtt_manager.c
    src/power_manager.c
    src/ble_diag.c
)

target_include_directories(app PRIVATE
    src
    ${CMAKE_CURRENT_SOURCE_DIR}/../../modules/kargo_drivers/utils/flash_buffer
)
```

## prj.conf
```kconfig
# SPDX-License-Identifier: Apache-2.0
# Copyright (c) 2025 Kargo Chain
# KargoPod Application Configuration

# Kernel Configuration
CONFIG_MAIN_STACK_SIZE=4096
CONFIG_SYSTEM_WORKQUEUE_STACK_SIZE=2048
CONFIG_HEAP_MEM_POOL_SIZE=131072

# Network
CONFIG_NETWORKING=y
CONFIG_NET_IPV4=y
CONFIG_NET_TCP=y
CONFIG_NET_SOCKETS=y
CONFIG_NET_SOCKETS_POSIX_NAMES=y

# MQTT
CONFIG_MQTT_LIB=y
CONFIG_MQTT_LIB_TLS=y
CONFIG_DNS_RESOLVER=y

# TLS/Security
CONFIG_MBEDTLS=y
CONFIG_MBEDTLS_BUILTIN=y
CONFIG_MBEDTLS_ENABLE_HEAP=y
CONFIG_MBEDTLS_HEAP_SIZE=65536
CONFIG_MBEDTLS_SSL_MAX_CONTENT_LEN=4096
CONFIG_MBEDTLS_KEY_EXCHANGE_RSA_ENABLED=y
CONFIG_MBEDTLS_CIPHER_AES_ENABLED=y
CONFIG_TLS_CREDENTIALS=y
CONFIG_TLS_MAX_CREDENTIALS_NUMBER=4

# Sensors
CONFIG_SENSOR=y
CONFIG_SENSOR_LOG_LEVEL_INF=y
CONFIG_I2C=y

# Kargo Custom Drivers
CONFIG_KARGO_DRIVERS=y
CONFIG_KARGO_SENSOR_SHT4X=y
CONFIG_KARGO_SENSOR_LIS3DH=y
CONFIG_KARGO_FLASH_BUFFER=y
CONFIG_KARGO_FLASH_BUFFER_SIZE=100
CONFIG_KARGO_POWER_MGMT=y

# Kargo Communication
CONFIG_KARGO_COMM=y
CONFIG_KARGO_MQTT=y
CONFIG_KARGO_MQTT_KEEPALIVE_SEC=60
CONFIG_KARGO_MQTT_RECONNECT_DELAY_MS=5000
CONFIG_KARGO_MQTT_BUFFER_SIZE=512

# Flash & Storage
CONFIG_FLASH=y
CONFIG_FLASH_MAP=y
CONFIG_FLASH_PAGE_LAYOUT=y
CONFIG_NVS=y
CONFIG_NVS_LOG_LEVEL_INF=y

# Bluetooth (for diagnostics)
CONFIG_BT=y
CONFIG_BT_PERIPHERAL=y
CONFIG_BT_DEVICE_NAME="KargoPod"
CONFIG_BT_DEVICE_APPEARANCE=833
CONFIG_BT_MAX_CONN=1
CONFIG_BT_MAX_PAIRED=1
CONFIG_BT_GATT_DYNAMIC_DB=y

# Power Management
CONFIG_PM=y
CONFIG_PM_DEVICE=y
CONFIG_PM_DEVICE_RUNTIME=y
CONFIG_PM_POLICY_DEFAULT=y

# Logging
CONFIG_LOG=y
CONFIG_LOG_DEFAULT_LEVEL=3
CONFIG_LOG_MODE_DEFERRED=y
CONFIG_LOG_BUFFER_SIZE=2048
CONFIG_LOG_PRINTK=y
CONFIG_LOG_PROCESS_THREAD_STACK_SIZE=2048

# System
CONFIG_REBOOT=y
CONFIG_WATCHDOG=y
CONFIG_RESET_ON_FATAL_ERROR=y

# Thread monitoring
CONFIG_THREAD_NAME=y
CONFIG_THREAD_MONITOR=y

# MCUboot support for OTA
CONFIG_BOOTLOADER_MCUBOOT=y
CONFIG_IMG_MANAGER=y
CONFIG_STREAM_FLASH=y
CONFIG_MCUBOOT_IMG_MANAGER=y

# Console
CONFIG_CONSOLE=y
CONFIG_UART_CONSOLE=y

# Shell (optional, for debugging)
CONFIG_SHELL=y
CONFIG_SHELL_BACKEND_SERIAL=y
CONFIG_KERNEL_SHELL=y
CONFIG_DEVICE_SHELL=y

# Timing and timers
CONFIG_POSIX_CLOCK=y
CONFIG_EVENTFD=y

# Networking optimizations
CONFIG_NET_BUF_RX_COUNT=16
CONFIG_NET_BUF_TX_COUNT=16
CONFIG_NET_PKT_RX_COUNT=16
CONFIG_NET_PKT_TX_COUNT=16
CONFIG_NET_MAX_CONTEXTS=8

# Application specific
CONFIG_APP_SENSOR_READ_INTERVAL_MIN=15
CONFIG_APP_DEEP_SLEEP_ENABLED=y
CONFIG_APP_BLE_DIAG_ENABLED=y

# AWS IoT Configuration (to be set via overlay or environment)
# CONFIG_AWS_IOT_ENDPOINT=""
# CONFIG_AWS_IOT_CLIENT_ID=""
# CONFIG_AWS_IOT_SEC_TAG=1
```

## esp32s3.conf
```kconfig
# SPDX-License-Identifier: Apache-2.0
# Copyright (c) 2025 Kargo Chain
# WiFi configuration overlay for ESP32-S3

# WiFi credentials (override these)
CONFIG_WIFI_SSID="YourWiFiSSID"
CONFIG_WIFI_PASSWORD="YourWiFiPassword"

# AWS IoT Configuration
CONFIG_AWS_IOT_ENDPOINT="your-endpoint.iot.us-east-1.amazonaws.com"
CONFIG_AWS_IOT_CLIENT_ID="kargopod-001"
CONFIG_AWS_IOT_SEC_TAG=1

# Network buffer sizes (tuned for ESP32-S3)
CONFIG_NET_BUF_RX_COUNT=16
CONFIG_NET_BUF_TX_COUNT=16
CONFIG_NET_PKT_RX_COUNT=16
CONFIG_NET_PKT_TX_COUNT=16

# ESP32 WiFi optimizations
CONFIG_ESP32_WIFI_STA_AUTO_DHCPV4=y
CONFIG_ESP32_WIFI_NET_ALLOC_SPIRAM=y

# Logging level for WiFi debugging
CONFIG_WIFI_LOG_LEVEL_INF=y
```

## nrf9160.conf
```kconfig
# SPDX-License-Identifier: Apache-2.0
# Copyright (c) 2025 Kargo Chain
# nRF9160 configuration overlay

# LTE configuration
CONFIG_LTE_LINK_CONTROL=y
CONFIG_LTE_AUTO_INIT_AND_CONNECT=n
CONFIG_LTE_NETWORK_MODE_LTE_M=y
CONFIG_LTE_NETWORK_MODE_NBIOT=y
CONFIG_LTE_MODE_PREFERENCE_LTE_M=y

# Power saving
CONFIG_LTE_PSM_REQ=y
CONFIG_LTE_PSM_REQ_RPTAU="00000111"  # 70 minutes
CONFIG_LTE_PSM_REQ_RAT="00000000"    # 0 seconds
CONFIG_LTE_EDRX_REQ=y
CONFIG_LTE_EDRX_REQ_VALUE_LTE_M="0101"  # 81.92 seconds

# nRF modem
CONFIG_NRF_MODEM_LIB=y
CONFIG_NRF_MODEM_LIB_SYS_INIT=y
CONFIG_NRF_MODEM_LIB_TRACE=n

# GNSS
CONFIG_GNSS=y
CONFIG_KARGO_GNSS=y
CONFIG_KARGO_GNSS_NRF9160=y

# AWS IoT Configuration
CONFIG_AWS_IOT_ENDPOINT="your-endpoint.iot.us-east-1.amazonaws.com"
CONFIG_AWS_IOT_CLIENT_ID="kargopod-nrf-001"
CONFIG_AWS_IOT_SEC_TAG=1

# Network optimizations for LTE-M
CONFIG_NET_SOCKETS_OFFLOAD=y
CONFIG_NET_NATIVE=n

# Modem key management
CONFIG_MODEM_KEY_MGMT=y

# Date/Time
CONFIG_DATE_TIME=y
CONFIG_DATE_TIME_AUTO_UPDATE=y

# Logging (reduced for power saving)
CONFIG_LOG_MODE_DEFERRED=y
CONFIG_LOG_BUFFER_SIZE=1024
```

## src/main.c
```c
/*
 * Copyright (c) 2025 Kargo Chain
 * SPDX-License-Identifier: Apache-2.0
 * 
 * KargoPod Main Application
 * Reads sensors every 15 minutes, buffers offline, publishes via MQTT
 */

#include <zephyr/kernel.h>
#include <zephyr/device.h>
#include <zephyr/logging/log.h>
#include <zephyr/sys/reboot.h>
#include <zephyr/drivers/watchdog.h>

#include "sensor_manager.h"
#include "mqtt_manager.h"
#include "power_manager.h"
#include "ble_diag.h"

LOG_MODULE_REGISTER(main, LOG_LEVEL_INF);

/* Application configuration */
#define SENSOR_READ_INTERVAL_MS    (CONFIG_APP_SENSOR_READ_INTERVAL_MIN * 60 * 1000)
#define WATCHDOG_TIMEOUT_MS        300000  /* 5 minutes */

static const struct device *wdt_dev;
static int wdt_channel_id;

/* Function declarations */
static int init_watchdog(void);
static void main_loop(void);

int main(void)
{
	int ret;

	LOG_INF("========================================");
	LOG_INF("  KargoPod IoT Application");
	LOG_INF("  Version: 1.0.0");
	LOG_INF("  Build: " __DATE__ " " __TIME__);
	LOG_INF("========================================");

	/* Initialize watchdog */
	ret = init_watchdog();
	if (ret < 0) {
		LOG_ERR("Watchdog init failed: %d", ret);
		/* Continue without watchdog */
	}

	/* Initialize sensor manager */
	ret = sensor_manager_init();
	if (ret < 0) {
		LOG_ERR("Sensor manager init failed: %d", ret);
		return ret;
	}

	/* Initialize power manager */
	ret = power_manager_init();
	if (ret < 0) {
		LOG_ERR("Power manager init failed: %d", ret);
		return ret;
	}

	/* Initialize MQTT manager */
	ret = mqtt_manager_init();
	if (ret < 0) {
		LOG_ERR("MQTT manager init failed: %d", ret);
		/* Continue - will buffer readings */
	}

#ifdef CONFIG_APP_BLE_DIAG_ENABLED
	/* Initialize BLE diagnostic mode */
	ret = ble_diag_init();
	if (ret < 0) {
		LOG_WRN("BLE diagnostic init failed: %d", ret);
		/* Continue without BLE */
	}
#endif

	LOG_INF("All subsystems initialized");
	LOG_INF("Sensor read interval: %d minutes", CONFIG_APP_SENSOR_READ_INTERVAL_MIN);

	/* Enter main application loop */
	main_loop();

	/* Should never reach here */
	return 0;
}

static int init_watchdog(void)
{
	struct wdt_timeout_cfg wdt_config;

	wdt_dev = DEVICE_DT_GET(DT_ALIAS(watchdog0));
	if (!device_is_ready(wdt_dev)) {
		LOG_ERR("Watchdog device not ready");
		return -ENODEV;
	}

	wdt_config.flags = WDT_FLAG_RESET_SOC;
	wdt_config.window.min = 0U;
	wdt_config.window.max = WATCHDOG_TIMEOUT_MS;
	wdt_config.callback = NULL;

	wdt_channel_id = wdt_install_timeout(wdt_dev, &wdt_config);
	if (wdt_channel_id < 0) {
		LOG_ERR("Watchdog install failed: %d", wdt_channel_id);
		return wdt_channel_id;
	}

	wdt_setup(wdt_dev, WDT_OPT_PAUSE_HALTED_BY_DBG);

	LOG_INF("Watchdog initialized (timeout: %d ms)", WATCHDOG_TIMEOUT_MS);
	return 0;
}

static void main_loop(void)
{
	struct sensor_data data;
	uint32_t cycle_count = 0;
	int ret;

	while (1) {
		cycle_count++;
		LOG_INF("=== Cycle %u ===", cycle_count);

		/* Feed watchdog */
		if (wdt_dev) {
			wdt_feed(wdt_dev, wdt_channel_id);
		}

		/* Read sensors */
		ret = sensor_manager_read(&data);
		if (ret < 0) {
			LOG_ERR("Sensor read failed: %d", ret);
		} else {
			LOG_INF("Sensors read successfully");
			LOG_INF("  Temp: %.2f°C, Humidity: %.2f%%",
				data.temperature, data.humidity);
			LOG_INF("  Accel: X=%.2f Y=%.2f Z=%.2f m/s²",
				data.accel_x, data.accel_y, data.accel_z);
			
			if (data.gnss_valid) {
				LOG_INF("  GPS: %.6f, %.6f", data.latitude, data.longitude);
			}

			/* Publish reading via MQTT (will buffer if offline) */
			ret = mqtt_manager_publish(&data);
			if (ret < 0) {
				LOG_WRN("MQTT publish failed: %d (buffered)", ret);
			}
		}

		/* Update diagnostics */
#ifdef CONFIG_APP_BLE_DIAG_ENABLED
		ble_diag_update_status(mqtt_manager_is_connected(), 
				       sensor_manager_get_reading_count());
#endif

		/* Check if we should enter deep sleep */
#ifdef CONFIG_APP_DEEP_SLEEP_ENABLED
		if (!mqtt_manager_is_connected() && 
		    !ble_diag_is_connected() &&
		    sensor_manager_get_reading_count() > 0) {
			LOG_INF("Entering power save mode");
			power_manager_deep_sleep(SENSOR_READ_INTERVAL_MS);
		} else {
			/* Normal sleep */
			k_sleep(K_MSEC(SENSOR_READ_INTERVAL_MS));
		}
#else
		/* Normal sleep without deep sleep */
		k_sleep(K_MSEC(SENSOR_READ_INTERVAL_MS));
#endif
	}
}
```

## src/ble_diag.c
```c
/*
 * Copyright (c) 2025 Kargo Chain
 * SPDX-License-Identifier: Apache-2.0
 */

#include "ble_diag.h"
#include <zephyr/bluetooth/bluetooth.h>
#include <zephyr/bluetooth/gap.h>
#include <zephyr/bluetooth/gatt.h>
#include <zephyr/bluetooth/uuid.h>
#include <zephyr/logging/log.h>
#include <stdio.h>

LOG_MODULE_REGISTER(ble_diag, LOG_LEVEL_INF);

/* Custom service UUID: 12345678-1234-5678-1234-56789abcdef0 */
#define BT_UUID_KARGO_SERVICE  BT_UUID_DECLARE_128( \
	BT_UUID_128_ENCODE(0x12345678, 0x1234, 0x5678, 0x1234, 0x56789abcdef0))

/* Diagnostic characteristic UUID: 12345678-1234-5678-1234-56789abcdef1 */
#define BT_UUID_KARGO_DIAG  BT_UUID_DECLARE_128( \
	BT_UUID_128_ENCODE(0x12345678, 0x1234, 0x5678, 0x1234, 0x56789abcdef1))

static char diag_data[256] = "KargoPod ready";
static bool client_connected = false;
static bool initialized = false;

/* BLE callbacks */
static void connected_cb(struct bt_conn *conn, uint8_t err)
{
	if (err) {
		LOG_ERR("BLE connection failed: %u", err);
	} else {
		LOG_INF("BLE client connected");
		client_connected = true;
	}
}

static void disconnected_cb(struct bt_conn *conn, uint8_t reason)
{
	LOG_INF("BLE client disconnected: %u", reason);
	client_connected = false;
}

BT_CONN_CB_DEFINE(conn_callbacks) = {
	.connected = connected_cb,
	.disconnected = disconnected_cb,
};

/* GATT characteristics */
static ssize_t read_diag(struct bt_conn *conn, const struct bt_gatt_attr *attr,
			 void *buf, uint16_t len, uint16_t offset)
{
	const char *value = diag_data;
	return bt_gatt_attr_read(conn, attr, buf, len, offset, value, strlen(value));
}

static ssize_t write_diag(struct bt_conn *conn, const struct bt_gatt_attr *attr,
			  const void *buf, uint16_t len, uint16_t offset, uint8_t flags)
{
	if (offset + len > sizeof(diag_data) - 1) {
		return BT_GATT_ERR(BT_ATT_ERR_INVALID_OFFSET);
	}

	memcpy(diag_data + offset, buf, len);
	diag_data[offset + len] = '\0';

	LOG_INF("Diagnostic command received: %s", diag_data);

	/* Parse and handle commands */
	if (strcmp(diag_data, "reboot") == 0) {
		LOG_WRN("Reboot requested via BLE");
		/* sys_reboot(SYS_REBOOT_WARM); */
	}

	return len;
}

/* GATT service definition */
BT_GATT_SERVICE_DEFINE(kargo_svc,
	BT_GATT_PRIMARY_SERVICE(BT_UUID_KARGO_SERVICE),
	BT_GATT_CHARACTERISTIC(BT_UUID_KARGO_DIAG,
			       BT_GATT_CHRC_READ | BT_GATT_CHRC_WRITE,
			       BT_GATT_PERM_READ | BT_GATT_PERM_WRITE,
			       read_diag, write_diag, diag_data),
);

/* Advertising data */
static const struct bt_data ad[] = {
	BT_DATA_BYTES(BT_DATA_FLAGS, (BT_LE_AD_GENERAL | BT_LE_AD_NO_BREDR)),
	BT_DATA_BYTES(BT_DATA_UUID128_ALL,
		      BT_UUID_128_ENCODE(0x12345678, 0x1234, 0x5678, 0x1234, 0x56789abcdef0)),
};

int ble_diag_init(void)
{
	int err;

	if (initialized) {
		return 0;
	}

	LOG_INF("Initializing BLE diagnostic mode...");

	/* Enable Bluetooth */
	err = bt_enable(NULL);
	if (err) {
		LOG_ERR("Bluetooth init failed: %d", err);
		return err;
	}

	LOG_INF("Bluetooth initialized");

	/* Start advertising */
	err = bt_le_adv_start(BT_LE_ADV_CONN_NAME, ad, ARRAY_SIZE(ad), NULL, 0);
	if (err) {
		LOG_ERR("Advertising failed to start: %d", err);
		return err;
	}

	LOG_INF("BLE advertising started");
	initialized = true;

	return 0;
}

void ble_diag_update_status(bool mqtt_connected, uint32_t reading_count)
{
	if (!initialized) {
		return;
	}

	snprintf(diag_data, sizeof(diag_data),
		 "MQTT:%s Readings:%u Uptime:%lld",
		 mqtt_connected ? "ON" : "OFF",
		 reading_count,
		 k_uptime_get() / 1000);
}

bool ble_diag_is_connected(void)
{
	return client_connected;
}
```

## src/ble_diag.h
```c
/*
 * Copyright (c) 2025 Kargo Chain
 * SPDX-License-Identifier: Apache-2.0
 */

#ifndef BLE_DIAG_H_
#define BLE_DIAG_H_

#include <zephyr/kernel.h>
#include <stdbool.h>

#ifdef __cplusplus
extern "C" {
#endif

/**
 * @brief Initialize BLE diagnostic mode
 * @return 0 on success, negative errno on failure
 */
int ble_diag_init(void);

/**
 * @brief Update diagnostic status
 * @param mqtt_connected MQTT connection status
 * @param reading_count Total reading count
 */
void ble_diag_update_status(bool mqtt_connected, uint32_t reading_count);

/**
 * @brief Check if BLE client is connected
 * @return true if connected, false otherwise
 */
bool ble_diag_is_connected(void);

#ifdef __cplusplus
}
#endif

#endif /* BLE_DIAG_H_ */
```

## src/mqtt_manager.c
```c
/*
 * Copyright (c) 2025 Kargo Chain
 * SPDX-License-Identifier: Apache-2.0
 */

#include "mqtt_manager.h"
#include "kargo_flash_buffer.h"
#include <zephyr/net/mqtt.h>
#include <zephyr/net/socket.h>
#include <zephyr/logging/log.h>
#include <zephyr/net/tls_credentials.h>
#include <stdio.h>
#include <string.h>

LOG_MODULE_REGISTER(mqtt_mgr, LOG_LEVEL_INF);

/* MQTT configuration */
#define MQTT_BROKER         CONFIG_AWS_IOT_ENDPOINT
#define MQTT_PORT           8883
#define MQTT_CLIENT_ID      CONFIG_AWS_IOT_CLIENT_ID
#define MQTT_TOPIC          "kargo/sensors/" CONFIG_AWS_IOT_CLIENT_ID "/data"
#define MQTT_KEEPALIVE      CONFIG_KARGO_MQTT_KEEPALIVE_SEC
#define MQTT_BUFFER_SIZE    CONFIG_KARGO_MQTT_BUFFER_SIZE

static struct mqtt_client client;
static struct sockaddr_storage broker;
static uint8_t rx_buffer[MQTT_BUFFER_SIZE];
static uint8_t tx_buffer[MQTT_BUFFER_SIZE];
static uint8_t payload_buffer[MQTT_BUFFER_SIZE];
static bool connected = false;
static bool initialized = false;

K_THREAD_STACK_DEFINE(mqtt_thread_stack, 4096);
static struct k_thread mqtt_thread_data;

/* Forward declarations */
static void mqtt_evt_handler(struct mqtt_client *client, const struct mqtt_evt *evt);
static void mqtt_thread_fn(void *p1, void *p2, void *p3);
static int mqtt_connect(void);

int mqtt_manager_init(void)
{
	int ret;

	if (initialized) {
		return 0;
	}

	LOG_INF("Initializing MQTT manager...");

	/* Initialize flash buffer for offline storage */
	ret = kargo_flash_buffer_init();
	if (ret < 0) {
		LOG_ERR("Flash buffer init failed: %d", ret);
		return ret;
	}

	/* Initialize MQTT client */
	mqtt_client_init(&client);

	struct sockaddr_in *broker4 = (struct sockaddr_in *)&broker;
	broker4->sin_family = AF_INET;
	broker4->sin_port = htons(MQTT_PORT);
	
	/* Note: DNS resolution should happen at runtime */
	/* For now, IP address needs to be configured */

	client.broker = &broker;
	client.evt_cb = mqtt_evt_handler;
	client.client_id.utf8 = (uint8_t *)MQTT_CLIENT_ID;
	client.client_id.size = strlen(MQTT_CLIENT_ID);
	client.protocol_version = MQTT_VERSION_3_1_1;
	client.keepalive = MQTT_KEEPALIVE;
	client.clean_session = 1;

	client.rx_buf = rx_buffer;
	client.rx_buf_size = sizeof(rx_buffer);
	client.tx_buf = tx_buffer;
	client.tx_buf_size = sizeof(tx_buffer);

	/* TLS configuration */
	struct mqtt_sec_config *tls_config = &client.transport.tls.config;
	tls_config->peer_verify = TLS_PEER_VERIFY_REQUIRED;
	tls_config->cipher_list = NULL;
	tls_config->sec_tag_list = (sec_tag_t[]){CONFIG_AWS_IOT_SEC_TAG};
	tls_config->sec_tag_count = 1;
	tls_config->hostname = MQTT_BROKER;

	client.transport.type = MQTT_TRANSPORT_SECURE;

	/* Start MQTT thread */
	k_thread_create(&mqtt_thread_data, mqtt_thread_stack,
			K_THREAD_STACK_SIZEOF(mqtt_thread_stack),
			mqtt_thread_fn, NULL, NULL, NULL,
			7, 0, K_NO_WAIT);
	k_thread_name_set(&mqtt_thread_data, "mqtt");

	initialized = true;
	LOG_INF("MQTT manager initialized");

	return 0;
}

int mqtt_manager_publish(const struct sensor_data *data)
{
	struct mqtt_publish_param param;
	struct kargo_sensor_reading reading;
	int ret;

	if (!initialized) {
		return -EINVAL;
	}

	/* Convert to buffer format */
	reading.timestamp = data->timestamp;
	reading.temperature = data->temperature;
	reading.humidity = data->humidity;
	reading.accel_x = data->accel_x;
	reading.accel_y = data->accel_y;
	reading.accel_z = data->accel_z;
	reading.latitude = data->latitude;
	reading.longitude = data->longitude;
	reading.gnss_valid = data->gnss_valid;

	if (!connected) {
		LOG_WRN("MQTT not connected, buffering reading");
		return kargo_flash_buffer_store(&reading);
	}

	/* Format JSON payload */
	snprintf(payload_buffer, sizeof(payload_buffer),
		"{\"ts\":%lld,\"temp\":%.2f,\"hum\":%.2f,"
		"\"acc\":{\"x\":%.2f,\"y\":%.2f,\"z\":%.2f},"
		"\"gps\":{\"lat\":%.6f,\"lon\":%.6f,\"valid\":%d}}",
		reading.timestamp,
		reading.temperature,
		reading.humidity,
		reading.accel_x,
		reading.accel_y,
		reading.accel_z,
		reading.latitude,
		reading.longitude,
		reading.gnss_valid);

	param.message.topic.qos = MQTT_QOS_1_AT_LEAST_ONCE;
	param.message.topic.topic.utf8 = (uint8_t *)MQTT_TOPIC;
	param.message.topic.topic.size = strlen(MQTT_TOPIC);
	param.message.payload.data = payload_buffer;
	param.message.payload.len = strlen(payload_buffer);
	param.message_id = sys_rand32_get();
	param.dup_flag = 0;
	param.retain_flag = 0;

	ret = mqtt_publish(&client, &param);
	if (ret) {
		LOG_ERR("MQTT publish failed: %d, buffering", ret);
		return kargo_flash_buffer_store(&reading);
	}

	LOG_INF("Published: %s", payload_buffer);
	return 0;
}

bool mqtt_manager_is_connected(void)
{
	return connected;
}

uint16_t mqtt_manager_get_buffered_count(void)
{
	return kargo_flash_buffer_count();
}

static void mqtt_evt_handler(struct mqtt_client *client, const struct mqtt_evt *evt)
{
	switch (evt->type) {
	case MQTT_EVT_CONNACK:
		if (evt->result == 0) {
			LOG_INF("MQTT connected!");
			connected = true;
		} else {
			LOG_ERR("MQTT connection failed: %d", evt->result);
			connected = false;
		}
		break;

	case MQTT_EVT_DISCONNECT:
		LOG_WRN("MQTT disconnected: %d", evt->result);
		connected = false;
		break;

	case MQTT_EVT_PUBACK:
		LOG_DBG("MQTT PUBACK: %u", evt->param.puback.message_id);
		break;

	default:
		break;
	}
}

static void mqtt_thread_fn(void *p1, void *p2, void *p3)
{
	struct zsock_pollfd fds[1];
	int ret;

	ARG_UNUSED(p1);
	ARG_UNUSED(p2);
	ARG_UNUSED(p3);

	LOG_INF("MQTT thread started");

	while (1) {
		if (!connected) {
			LOG_INF("Attempting MQTT connection...");
			ret = mqtt_connect();
			if (ret < 0) {
				LOG_ERR("MQTT connect failed: %d", ret);
				k_sleep(K_MSEC(CONFIG_KARGO_MQTT_RECONNECT_DELAY_MS));
				continue;
			}

			fds[0].fd = client.transport.tls.sock;
			fds[0].events = ZSOCK_POLLIN;
		}

		/* Process MQTT */
		if (connected) {
			ret = zsock_poll(fds, 1, mqtt_keepalive_time_left(&client));
			if (ret < 0) {
				LOG_ERR("Poll error: %d", errno);
				mqtt_disconnect(&client);
				connected = false;
				continue;
			}

			ret = mqtt_live(&client);
			if (ret != 0 && ret != -EAGAIN) {
				LOG_ERR("MQTT live error: %d", ret);
				mqtt_disconnect(&client);
				connected = false;
			}

			if (fds[0].revents & ZSOCK_POLLIN) {
				ret = mqtt_input(&client);
				if (ret != 0) {
					LOG_ERR("MQTT input error: %d", ret);
					mqtt_disconnect(&client);
					connected = false;
				}
			}

			/* Publish buffered readings */
			if (kargo_flash_buffer_count() > 0) {
				struct kargo_sensor_reading buffered;
				if (kargo_flash_buffer_retrieve(&buffered) == 0) {
					struct sensor_data data = {
						.timestamp = buffered.timestamp,
						.temperature = buffered.temperature,
						.humidity = buffered.humidity,
						.accel_x = buffered.accel_x,
						.accel_y = buffered.accel_y,
						.accel_z = buffered.accel_z,
						.latitude = buffered.latitude,
						.longitude = buffered.longitude,
						.gnss_valid = buffered.gnss_valid
					};
					mqtt_manager_publish(&data);
				}
			}
		}

		k_sleep(K_MSEC(100));
	}
}

static int mqtt_connect(void)
{
	/* In real implementation, perform DNS resolution and network setup */
	return mqtt_connect(&client);
}
```

## src/mqtt_manager.h
```c
/*
 * Copyright (c) 2025 Kargo Chain
 * SPDX-License-Identifier: Apache-2.0
 */

#ifndef MQTT_MANAGER_H_
#define MQTT_MANAGER_H_

#include <zephyr/kernel.h>
#include "sensor_manager.h"

#ifdef __cplusplus
extern "C" {
#endif

/**
 * @brief Initialize MQTT manager
 * @return 0 on success, negative errno on failure
 */
int mqtt_manager_init(void);

/**
 * @brief Publish sensor data to MQTT broker
 * @param data Pointer to sensor data
 * @return 0 on success, negative errno on failure
 */
int mqtt_manager_publish(const struct sensor_data *data);

/**
 * @brief Check if MQTT is connected
 * @return true if connected, false otherwise
 */
bool mqtt_manager_is_connected(void);

/**
 * @brief Get number of buffered messages
 * @return Number of buffered messages
 */
uint16_t mqtt_manager_get_buffered_count(void);

#ifdef __cplusplus
}
#endif

#endif /* MQTT_MANAGER_H_ */
```

## src/power_manager.c
```c
/*
 * Copyright (c) 2025 Kargo Chain
 * SPDX-License-Identifier: Apache-2.0
 */

#include "power_manager.h"
#include <zephyr/pm/pm.h>
#include <zephyr/pm/device.h>
#include <zephyr/drivers/adc.h>
#include <zephyr/logging/log.h>

LOG_MODULE_REGISTER(power_mgr, LOG_LEVEL_INF);

static bool initialized = false;

int power_manager_init(void)
{
	if (initialized) {
		return 0;
	}

	LOG_INF("Initializing power manager...");

	/* Configure power management */
#ifdef CONFIG_PM
	/* PM is auto-configured by Kconfig */
	LOG_INF("Power management enabled");
#else
	LOG_WRN("Power management not configured");
#endif

	initialized = true;
	LOG_INF("Power manager initialized");

	return 0;
}

int power_manager_deep_sleep(uint32_t duration_ms)
{
	if (!initialized) {
		return -EINVAL;
	}

	LOG_INF("Entering deep sleep for %u ms", duration_ms);

	/* On ESP32-S3: Use deep sleep */
	/* On nRF9160: Use System OFF or PSM mode */

#if defined(CONFIG_SOC_ESP32S3)
	/* ESP32-S3 deep sleep implementation */
	/* This requires esp_sleep APIs which would be included */
	/* For now, use regular sleep */
	k_sleep(K_MSEC(duration_ms));
#elif defined(CONFIG_SOC_NRF9160)
	/* nRF9160: Could use PSM (Power Saving Mode) */
	/* Or system off with wake timer */
	k_sleep(K_MSEC(duration_ms));
#else
	/* Generic sleep */
	k_sleep(K_MSEC(duration_ms));
#endif

	LOG_INF("Woke from deep sleep");
	return 0;
}

int power_manager_get_battery_mv(void)
{
	/* TODO: Implement ADC reading of battery voltage */
	/* This requires ADC configuration in device tree */
	
	/* For now, return a placeholder */
	return 3700; /* 3.7V typical Li-Po */
}
```

## src/power_manager.h
```c
/*
 * Copyright (c) 2025 Kargo Chain
 * SPDX-License-Identifier: Apache-2.0
 */

#ifndef POWER_MANAGER_H_
#define POWER_MANAGER_H_

#include <zephyr/kernel.h>

#ifdef __cplusplus
extern "C" {
#endif

/**
 * @brief Initialize power manager
 * @return 0 on success, negative errno on failure
 */
int power_manager_init(void);

/**
 * @brief Enter deep sleep mode
 * @param duration_ms Sleep duration in milliseconds
 * @return 0 on success, negative errno on failure
 */
int power_manager_deep_sleep(uint32_t duration_ms);

/**
 * @brief Get battery voltage
 * @return Battery voltage in millivolts, negative on error
 */
int power_manager_get_battery_mv(void);

#ifdef __cplusplus
}
#endif

#endif /* POWER_MANAGER_H_ */
```

## src/sensor_manager.c
```c
/*
 * Copyright (c) 2025 Kargo Chain
 * SPDX-License-Identifier: Apache-2.0
 */

#include "sensor_manager.h"
#include <zephyr/device.h>
#include <zephyr/drivers/sensor.h>
#include <zephyr/logging/log.h>

LOG_MODULE_REGISTER(sensor_mgr, LOG_LEVEL_INF);

static uint32_t reading_count = 0;
static bool initialized = false;

int sensor_manager_init(void)
{
	if (initialized) {
		return 0;
	}

	LOG_INF("Initializing sensors...");

	/* Sensors are auto-initialized by device tree */
	/* We just verify they're available */

	const struct device *sht4x = DEVICE_DT_GET_ANY(sensirion_sht4x);
	if (device_is_ready(sht4x)) {
		LOG_INF("SHT4x sensor ready");
	} else {
		LOG_WRN("SHT4x sensor not available");
	}

	const struct device *lis3dh = DEVICE_DT_GET_ANY(st_lis3dh);
	if (device_is_ready(lis3dh)) {
		LOG_INF("LIS3DH accelerometer ready");
	} else {
		LOG_WRN("LIS3DH accelerometer not available");
	}

	initialized = true;
	LOG_INF("Sensor manager initialized");

	return 0;
}

int sensor_manager_read(struct sensor_data *data)
{
	const struct device *sht4x = DEVICE_DT_GET_ANY(sensirion_sht4x);
	const struct device *lis3dh = DEVICE_DT_GET_ANY(st_lis3dh);
	struct sensor_value temp, humidity, accel[3];
	int ret;

	if (!initialized) {
		return -EINVAL;
	}

	/* Get timestamp */
	data->timestamp = k_uptime_get();
	data->gnss_valid = 0;
	data->latitude = 0.0f;
	data->longitude = 0.0f;

	/* Read SHT4x (temperature & humidity) */
	if (device_is_ready(sht4x)) {
		ret = sensor_sample_fetch(sht4x);
		if (ret == 0) {
			sensor_channel_get(sht4x, SENSOR_CHAN_AMBIENT_TEMP, &temp);
			sensor_channel_get(sht4x, SENSOR_CHAN_HUMIDITY, &humidity);
			
			data->temperature = sensor_value_to_float(&temp);
			data->humidity = sensor_value_to_float(&humidity);
			
			LOG_DBG("SHT4x: T=%.2f°C, RH=%.2f%%", 
				data->temperature, data->humidity);
		} else {
			LOG_ERR("SHT4x fetch failed: %d", ret);
			data->temperature = 0.0f;
			data->humidity = 0.0f;
		}
	} else {
		/* Use default values if sensor not available */
		data->temperature = 25.0f;
		data->humidity = 50.0f;
	}

	/* Read LIS3DH (accelerometer) */
	if (device_is_ready(lis3dh)) {
		ret = sensor_sample_fetch(lis3dh);
		if (ret == 0) {
			sensor_channel_get(lis3dh, SENSOR_CHAN_ACCEL_XYZ, accel);
			
			data->accel_x = sensor_value_to_float(&accel[0]);
			data->accel_y = sensor_value_to_float(&accel[1]);
			data->accel_z = sensor_value_to_float(&accel[2]);
			
			LOG_DBG("LIS3DH: X=%.2f Y=%.2f Z=%.2f m/s²",
				data->accel_x, data->accel_y, data->accel_z);
		} else {
			LOG_ERR("LIS3DH fetch failed: %d", ret);
			data->accel_x = 0.0f;
			data->accel_y = 0.0f;
			data->accel_z = 0.0f;
		}
	} else {
		/* Default gravity */
		data->accel_x = 0.0f;
		data->accel_y = 0.0f;
		data->accel_z = 9.81f;
	}

	/* TODO: Read GNSS (nRF9160 or u-blox M10) */
	/* For now, GNSS is marked as invalid */

	reading_count++;
	return 0;
}

uint32_t sensor_manager_get_reading_count(void)
{
	return reading_count;
}
```

## src/sensor_manager.h
```c
/*
 * Copyright (c) 2025 Kargo Chain
 * SPDX-License-Identifier: Apache-2.0
 */

#ifndef SENSOR_MANAGER_H_
#define SENSOR_MANAGER_H_

#include <zephyr/kernel.h>
#include <stdint.h>

#ifdef __cplusplus
extern "C" {
#endif

struct sensor_data {
	int64_t timestamp;
	float temperature;
	float humidity;
	float accel_x;
	float accel_y;
	float accel_z;
	float latitude;
	float longitude;
	uint8_t gnss_valid;
};

/**
 * @brief Initialize sensor manager
 * @return 0 on success, negative errno on failure
 */
int sensor_manager_init(void);

/**
 * @brief Read all sensors
 * @param data Pointer to store sensor data
 * @return 0 on success, negative errno on failure
 */
int sensor_manager_read(struct sensor_data *data);

/**
 * @brief Get total number of readings taken
 * @return Reading count
 */
uint32_t sensor_manager_get_reading_count(void);

#ifdef __cplusplus
}
#endif

#endif /* SENSOR_MANAGER_H_ */
```
