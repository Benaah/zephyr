## boards/kargo/kargopod_esp32s3/kargopod_esp32s3_defconfig
```kconfig
# SPDX-License-Identifier: Apache-2.0
# Copyright (c) 2025 Kargo Chain

# Network
CONFIG_NETWORKING=y
CONFIG_NET_IPV4=y
CONFIG_NET_IPV6=n
CONFIG_NET_TCP=y
CONFIG_NET_SOCKETS=y
CONFIG_NET_SOCKETS_POSIX_NAMES=y

# WiFi
CONFIG_WIFI=y
CONFIG_WIFI_ESP32=y
CONFIG_ESP32_WIFI_STA_AUTO_DHCPV4=y

# MQTT
CONFIG_MQTT_LIB=y
CONFIG_MQTT_LIB_TLS=y

# TLS
CONFIG_MBEDTLS=y
CONFIG_MBEDTLS_BUILTIN=y
CONFIG_MBEDTLS_ENABLE_HEAP=y
CONFIG_MBEDTLS_HEAP_SIZE=65536
CONFIG_MBEDTLS_SSL_MAX_CONTENT_LEN=4096

# Sensors
CONFIG_SENSOR=y
CONFIG_I2C=y

# Flash & Storage
CONFIG_FLASH=y
CONFIG_FLASH_MAP=y
CONFIG_NVS=y
CONFIG_NVS_LOG_LEVEL_DBG=n

# Bluetooth
CONFIG_BT=y
CONFIG_BT_PERIPHERAL=y
CONFIG_BT_DEVICE_NAME="KargoPod"
CONFIG_BT_DEVICE_APPEARANCE=833
CONFIG_BT_MAX_CONN=1

# Power Management
CONFIG_PM=y
CONFIG_PM_DEVICE=y

# Logging
CONFIG_LOG=y
CONFIG_LOG_DEFAULT_LEVEL=3
CONFIG_LOG_MODE_IMMEDIATE=n
CONFIG_LOG_PRINTK=y

# System
CONFIG_HEAP_MEM_POOL_SIZE=131072
CONFIG_MAIN_STACK_SIZE=4096
CONFIG_SYSTEM_WORKQUEUE_STACK_SIZE=2048

# MCUboot support
CONFIG_BOOTLOADER_MCUBOOT=y

# Watchdog
CONFIG_WATCHDOG=y
```

## boards/kargo/kargopod_nrf9160/kargopod_nrf9160_defconfig
```kconfig
# SPDX-License-Identifier: Apache-2.0
# Copyright (c) 2025 Kargo Chain

# Network
CONFIG_NETWORKING=y
CONFIG_NET_NATIVE=n
CONFIG_NET_IPV4=y
CONFIG_NET_IPV6=n
CONFIG_NET_TCP=y
CONFIG_NET_SOCKETS=y
CONFIG_NET_SOCKETS_OFFLOAD=y

# LTE connectivity
CONFIG_LTE_LINK_CONTROL=y
CONFIG_LTE_AUTO_INIT_AND_CONNECT=n
CONFIG_LTE_NETWORK_MODE_LTE_M=y
CONFIG_LTE_PSM_REQ=y
CONFIG_LTE_EDRX_REQ=y

# nRF Modem library
CONFIG_NRF_MODEM_LIB=y
CONFIG_NRF_MODEM_LIB_SYS_INIT=y

# MQTT
CONFIG_MQTT_LIB=y
CONFIG_MQTT_LIB_TLS=y

# TLS
CONFIG_MBEDTLS=y
CONFIG_MBEDTLS_BUILTIN=y
CONFIG_MBEDTLS_ENABLE_HEAP=y
CONFIG_MBEDTLS_HEAP_SIZE=32768
CONFIG_MBEDTLS_SSL_MAX_CONTENT_LEN=2048
CONFIG_MBEDTLS_TLS_VERSION_1_2=y

# GNSS
CONFIG_NRF_MODEM_LIB_TRACE=n
CONFIG_GNSS=y

# Sensors
CONFIG_SENSOR=y
CONFIG_I2C=y

# Flash & Storage
CONFIG_FLASH=y
CONFIG_FLASH_MAP=y
CONFIG_NVS=y
CONFIG_STREAM_FLASH=y
CONFIG_IMG_MANAGER=y

# Bluetooth
CONFIG_BT=y
CONFIG_BT_PERIPHERAL=y
CONFIG_BT_DEVICE_NAME="KargoPod"
CONFIG_BT_MAX_CONN=1

# Power Management
CONFIG_PM=y
CONFIG_PM_DEVICE=y
CONFIG_PM_DEVICE_RUNTIME=y

# Logging
CONFIG_LOG=y
CONFIG_LOG_DEFAULT_LEVEL=3
CONFIG_LOG_MODE_DEFERRED=y
CONFIG_LOG_PRINTK=y

# System
CONFIG_HEAP_MEM_POOL_SIZE=65536
CONFIG_MAIN_STACK_SIZE=4096
CONFIG_SYSTEM_WORKQUEUE_STACK_SIZE=2048

# MCUboot
CONFIG_BOOTLOADER_MCUBOOT=y

# Trusted Firmware-M
CONFIG_BUILD_WITH_TFM=y

# Watchdog
CONFIG_WATCHDOG=y
CONFIG_WDT_NRFX=y

# DFU
CONFIG_MCUBOOT_IMG_MANAGER=y
CONFIG_IMG_ERASE_PROGRESSIVELY=y

# Date Time library
CONFIG_DATE_TIME=y

# Modem key management
CONFIG_MODEM_KEY_MGMT=y
```

## modules/kargo_comm/Kconfig
```kconfig
# SPDX-License-Identifier: Apache-2.0
# Copyright (c) 2025 Kargo Chain

menuconfig KARGO_COMM
	bool "Kargo communication modules"
	help
	  Enable Kargo Chain communication and networking modules

if KARGO_COMM

config KARGO_MQTT
	bool "Kargo MQTT client wrapper"
	depends on NETWORKING
	depends on NET_TCP
	depends on MQTT_LIB
	help
	  Enable Kargo MQTT client wrapper for AWS IoT Core

if KARGO_MQTT

config KARGO_MQTT_KEEPALIVE_SEC
	int "MQTT keepalive interval (seconds)"
	default 60
	help
	  MQTT keepalive interval in seconds

config KARGO_MQTT_RECONNECT_DELAY_MS
	int "MQTT reconnection delay (milliseconds)"
	default 5000
	help
	  Delay between MQTT reconnection attempts

config KARGO_MQTT_BUFFER_SIZE
	int "MQTT buffer size"
	default 512
	help
	  Size of MQTT TX/RX buffers

endif # KARGO_MQTT

config KARGO_MODEM_NRF9160
	bool "nRF9160 modem support"
	depends on NRF_MODEM_LIB
	help
	  Enable support for nRF9160 integrated LTE-M/NB-IoT modem

config KARGO_MODEM_AT
	bool "External AT modem support"
	depends on MODEM
	help
	  Enable support for external AT-command based modems

config KARGO_GNSS
	bool "GNSS support"
	help
	  Enable GNSS functionality

if KARGO_GNSS

choice KARGO_GNSS_TYPE
	prompt "GNSS type"
	default KARGO_GNSS_NRF9160

config KARGO_GNSS_NRF9160
	bool "nRF9160 integrated GNSS"
	depends on KARGO_MODEM_NRF9160

config KARGO_GNSS_UBLOX_M10
	bool "u-blox M10 external GNSS"
	depends on UART

endchoice

config KARGO_GNSS_TIMEOUT_SEC
	int "GNSS fix timeout (seconds)"
	default 120
	help
	  Maximum time to wait for GNSS fix

endif # KARGO_GNSS

endif # KARGO_COMM
```

## modules/kargo_drivers/Kconfig
```kconfig
# SPDX-License-Identifier: Apache-2.0
# Copyright (c) 2025 Kargo Chain

menuconfig KARGO_DRIVERS
	bool "Kargo custom drivers"
	help
	  Enable Kargo Chain custom sensor and peripheral drivers

if KARGO_DRIVERS

# Sensor Drivers
menu "Sensor Drivers"

config KARGO_SENSOR_SHT4X
	bool "SHT4x temperature and humidity sensor"
	depends on I2C
	select SENSOR
	help
	  Enable driver for Sensirion SHT4x temperature and humidity sensor

config KARGO_SENSOR_BMA4XX
	bool "BMA4xx accelerometer"
	depends on I2C || SPI
	select SENSOR
	help
	  Enable driver for Bosch BMA4xx series accelerometer

config KARGO_SENSOR_LIS3DH
	bool "LIS3DH accelerometer wrapper"
	depends on I2C || SPI
	select SENSOR
	select LIS3DH
	help
	  Kargo wrapper for STMicro LIS3DH accelerometer

config KARGO_SENSOR_ALS
	bool "Ambient light sensor"
	depends on I2C
	select SENSOR
	help
	  Enable driver for ambient light sensor

endmenu

# Utility Modules
menu "Utility Modules"

config KARGO_POWER_MGMT
	bool "Kargo power management"
	depends on PM
	help
	  Enable Kargo-specific power management utilities

config KARGO_FLASH_BUFFER
	bool "Flash buffering for offline data"
	depends on FLASH
	depends on NVS
	help
	  Enable flash-based circular buffer for sensor data

config KARGO_FLASH_BUFFER_SIZE
	int "Maximum buffered readings"
	depends on KARGO_FLASH_BUFFER
	default 100
	help
	  Maximum number of sensor readings to buffer in flash

endmenu

endif # KARGO_DRIVERS
```
